## configs/optee_qemu_aarch64_defconfig
```kconfig
# Architecture
BR2_aarch64=y
BR2_TARGET_GENERIC_ISSUE="Welcome to Buildroot, type root to login"
#BR2_SYSTEM_DHCP="eth0"
BR2_TARGET_GENERIC_GETTY_PORT="ttyAMA0"
BR2_TARGET_ROOTFS_CPIO=y
BR2_TARGET_ROOTFS_CPIO_GZIP=y
# BR2_TARGET_ROOTFS_TAR is not set
BR2_PACKAGE_HOST_E2FSPROGS=y
BR2_PACKAGE_OPTEE_OS=y
BR2_PACKAGE_OPTEE_CLIENT=y
BR2_PACKAGE_OPTEE_TEST=y
BR2_PACKAGE_OPTEE_EXAMPLES=y
```

## configs/optee_qemu_v7_defconfig
```kconfig
BR2_arm=y
BR2_cortex_a15=y
BR2_ARM_FPU_VFPV3D16=y
BR2_ARM_INSTRUCTIONS_THUMB2=y
BR2_CCACHE=y
BR2_TARGET_GENERIC_ISSUE="Welcome to Buildroot, type root to login"
BR2_TARGET_GENERIC_GETTY_PORT="ttyAMA0"
# BR2_SYSTEM_DHCP="eth0"
BR2_TARGET_ROOTFS_CPIO=y
BR2_TARGET_ROOTFS_CPIO_GZIP=y
# BR2_TARGET_ROOTFS_TAR is not set
BR2_PACKAGE_HOST_E2FSPROGS=y
BR2_PACKAGE_OPTEE_OS=y
BR2_PACKAGE_OPTEE_CLIENT=y
BR2_PACKAGE_OPTEE_TEST=y
BR2_PACKAGE_OPTEE_EXAMPLES=y
```

## package/optee_client/Config.in
```kconfig
config BR2_PACKAGE_OPTEE_CLIENT
	bool "optee_client"
	help
	  http://github.org/OP-TEE/optee_client
```

## package/optee_examples/Config.in
```kconfig
config BR2_PACKAGE_OPTEE_EXAMPLES
	bool "optee_examples"
	help
	  http://github.org/OP-TEE/optee_examples

if BR2_PACKAGE_OPTEE_TEST

config BR2_PACKAGE_OPTEE_EXAMPLES_SDK
	string "OPTEE SDK path"
	default ""
	help
	  some help

endif
```

## package/optee_test/Config.in
```kconfig
config BR2_PACKAGE_OPTEE_TEST
	bool "optee_test"
	help
	  http://github.org/OP-TEE/optee_test

if BR2_PACKAGE_OPTEE_TEST

config BR2_PACKAGE_OPTEE_TEST_SDK
	string "OPTEE SDK path"
	default ""
	help
	  some help

endif
```
